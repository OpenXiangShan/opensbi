## platform/generic/xiangshan/Kconfig
```kconfig
# SPDX-License-Identifier: BSD-2-Clause
#
config XIANGSHAN_KMHV2_ERRNMI
	bool "xiangshan kmh_v2 nmi_handler support"
	default n
```

## platform/xiangshan/kmh/Kconfig
```kconfig
# SPDX-License-Identifier: BSD-2-Clause

config PLATFORM_KMH
	bool
	select FDT
	select IPI_MSWI
	select SERIAL_UART8250
	select SERIAL_VIRTIO_CONSOLE
	select TIMER_MTIMER
	default y
```
